## CMakeLists.txt
```
cmake_minimum_required(VERSION 3.20.0)

find_package(Zephyr)
project(my_zephyr_app)

target_include_directories(app PRIVATE src)
target_sources(app PRIVATE src/main.c)

target_sources_ifdef(CONFIG_APP_MODULE_COUNTDOWN app PRIVATE src/modules/countdown.c)
target_sources_ifdef(CONFIG_APP_MODULE_BLINK app PRIVATE src/modules/blink.c)
target_sources_ifdef(CONFIG_APP_MODULE_BUTTON_I app PRIVATE src/modules/button_i.c)
target_sources_ifdef(CONFIG_APP_MODULE_TEMP app PRIVATE src/modules/temp_read.c)
target_sources_ifdef(CONFIG_APP_MODULE_THREAD app PRIVATE src/modules/thread_mg.c)
target_sources_ifdef(CONFIG_APP_MODULE_LOG app PRIVATE src/modules/logging_system.c)
target_sources_ifdef(CONFIG_APP_MODULE_CONDVAR app PRIVATE src/modules/condvar.c)
# cambia userspace.c per vedere il primo modulo
target_sources_ifdef(CONFIG_APP_MODULE_USERSPACE app PRIVATE src/modules/userspace_2.c)
target_sources_ifdef(CONFIG_APP_MODULE_SYSCALL app PRIVATE src/modules/syscall_user.c)
target_sources_ifdef(CONFIG_APP_MODULE_PSA app PRIVATE src/modules/psa_key.c)
```

## Kconfig
```
# Opzioni specifiche di questa applicazione.
# ATTENZIONE: "source Kconfig.zephyr" alla fine e' obbligatorio.

menu "Test Zephyr - moduli di apprendimento"

config APP_MODULE_COUNTDOWN
	bool "Countdown avviato da pulsante"
	depends on GPIO
	help
	  Attende la pressione di sw0, esegue un countdown lampeggiando il LED
	  verde, poi alterna rosso/blu all'infinito.

config APP_MODULE_COUNTDOWN_START
	int "Valore iniziale del countdown"
	depends on APP_MODULE_COUNTDOWN
	default 10
	range 1 60

config APP_MODULE_BLINK
	bool "Blink semplice su led0"
	depends on GPIO
	help
	  Lampeggio base di led0. 

config APP_MODULE_BLINK_PERIOD_MS
	int "Periodo di lampeggio (ms)"
	depends on APP_MODULE_BLINK
	default 500

config APP_MODULE_BUTTON_I
	bool "Pulsante gestito a interrupt"
	depends on GPIO
	help
	  Reagisce a sw0 tramite callback invece che polling.
	  
config APP_MODULE_TEMP
	bool "Lettura temperatura del die da pulsante"
	depends on GPIO
	help
	  Legge il sensore di temperatura interno alla pressione di sw0.
	  
config APP_MODULE_THREAD
	bool "Esercizio thread + contatore"
	depends on GPIO
	help
	  Stampa il contatore di blink.

config APP_MODULE_LOG
	bool "confronto tipi di log"
	help
	  confronta i vari tipi di log

config APP_MODULE_CONDVAR
	bool "gestione dei thread tramite condvar"
	help
	  Esempio Produttore e Consumatore con buffer circolare condiviso, protetto da mutex e regolato tramite 
	  condition variables

config APP_MODULE_USERSPACE
	bool "errore accesso da userspace"
	help	
	  Esempio di messaggio errore accesso negato ad una variabile tramite thread non privilegiato

config APP_MODULE_SYSCALL
	bool "validazione puntatore in syscall"
	help	
	  Un thread user chiama una syscall passando come buffer un puntatore a memoria che non gli appartiene

config APP_MODULE_PSA
	bool "cifratura di testo sample"
	help
	  Genera una chiave di cifratura che viene usata per criptare prima e poi decriptare un testo.
	  La chiave viene poi distrutta

endmenu

source "Kconfig.zephyr"
```

## prj.conf
```kconfig
#Configurazione con TustZone attiva 
#(commentare se Trust Zone non è attiva)
CONFIG_BUILD_WITH_TFM=y
#CONFIG_TFM_PROFILE_TYPE_MEDIUM=y
#CONFIG_TFM_ISOLATION_LEVEL=1 

#Per log e thread info decommentare i seguenti

CONFIG_LOG=y
CONFIG_LOG_DEFAULT_LEVEL=4
#CONFIG_LOG_BACKEND_UART=y
#CONFIG_LOG_BACKEND_SHOW_COLOR=n
#CONFIG_LOG_PRINTK=y
#CONFIG_LOG_MODE_DEFERRED=y
#CONFIG_LOG_BUFFER_SIZE=4096
#CONFIG_LOG_PROCESS_THREAD_STACK_SIZE=2048
#CONFIG_THREAD_NAME=y
#CONFIG_THREAD_ANALYZER=y
#CONFIG_THREAD_ANALYZER_USE_LOG=y
#CONFIG_THREAD_ANALYZER_AUTO=y
#CONFIG_THREAD_ANALYZER_AUTO_INTERVAL=10
#CONFIG_THREAD_RUNTIME_STATS=y
#CONFIG_INIT_STACKS=y
CONFIG_HW_STACK_PROTECTION=y
#CONFIG_GPIO=y
CONFIG_PRINTK=y
#CONFIG_SENSOR=y
#CONFIG_ADC=y
#CONFIG_USERSPACE=y
#CONFIG_MPU=y
CONFIG_EXCEPTION_DEBUG=y
#CONFIG_SIZE_OPTIMIZATIONS=y

# Chiavi crittografiche
CONFIG_PSA_WANT_KEY_TYPE_AES=y
CONFIG_PSA_WANT_ALG_CTR=y

# Stack del tread main aumentato :
# il boot passa attraverso il boundary secure/non-secure e alcune inizializzazioni consumano più stack
CONFIG_MAIN_STACK_SIZE=4096

#Alterna tra i vari moduli commentando/decommentando.
#CONFIG_APP_MODULE_COUNTDOWN=y
#CONFIG_APP_MODULE_BLINK=y
#CONFIG_APP_MODULE_BUTTON_I=y
#CONFIG_APP_MODULE_TEMP=y
#CONFIG_APP_MODULE_CONDVAR=y
#CONFIG_APP_MODULE_USERSPACE=y
#CONFIG_APP_MODULE_SYSCALL=y
#CONFIG_APP_MODULE_THREAD=y
#CONFIG_APP_MODULE_LOG=y
CONFIG_APP_MODULE_PSA=y
```

## app.overlay
```dts
&adc1 {
	status = "okay";
};

&die_temp {
	status = "okay";
};
```

## src/main.c
```c
#include <zephyr/kernel.h>
#include <zephyr/drivers/gpio.h>
#include "modules.h"

//Esercizio sulla gestione della memoria 
/*
static const uint8_t buffer_const[1024] = {1};   // atteso: flash (.rodata)
static uint8_t buffer_bss[1024];                  // atteso: RAM (.bss)
static uint8_t buffer_data[1024] = {1};           // atteso: RAM (.data) + flash
*/

int main(void)
{
/*
	buffer_bss[0] = buffer_const[0];
    buffer_data[0] = buffer_bss[0];
    printk("const=%p bss=%p data=%p\n",
           (void *)buffer_const, (void *)buffer_bss, (void *)buffer_data);
*/
	printk("Test Zephyr: avvio\n");
	#if defined(CONFIG_APP_MODULE_COUNTDOWN)
		module_countdown_run();
	#elif defined(CONFIG_APP_MODULE_BLINK)
		module_blink_run();
	#elif defined(CONFIG_APP_MODULE_BUTTON_I)
		module_button_i_run();
	#elif defined(CONFIG_APP_MODULE_TEMP)
		module_temp_read_run();
	#elif defined(CONFIG_APP_MODULE_THREAD)
		module_thread_run();
	#elif defined(CONFIG_APP_MODULE_LOG)
		module_log_run();
	#elif defined (CONFIG_APP_MODULE_CONDVAR)
		module_condvar_run();
	#elif defined (CONFIG_APP_MODULE_USERSPACE)
		module_user_run();
	#elif defined (CONFIG_APP_MODULE_SYSCALL)
		module_syscall_ptr_run();
	#elif defined (CONFIG_APP_MODULE_PSA)
		module_psa_key_run();
	#else
		printk("Nessun modulo attivo\n");
	#endif
	return 0;
}
```

## src/modules.h
```c
#ifndef APP_MODULES_H
#define APP_MODULES_H

#ifdef CONFIG_APP_MODULE_COUNTDOWN
void module_countdown_run(void);
#endif

#ifdef CONFIG_APP_MODULE_BLINK
void module_blink_run(void);
#endif

#ifdef CONFIG_APP_MODULE_BUTTON_I
void module_button_i_run(void);
#endif

#ifdef CONFIG_APP_MODULE_TEMP
void module_temp_read_run(void);
#endif

#ifdef CONFIG_APP_MODULE_THREAD
void module_thread_run(void);
#endif

#ifdef CONFIG_APP_MODULE_LOG
void module_log_run (void);
#endif

#ifdef CONFIG_APP_MODULE_CONDVAR
void module_condvar_run(void);
#endif

#ifdef CONFIG_APP_MODULE_USERSPACE
void module_user_run(void);
#endif

#ifdef CONFIG_APP_MODULE_SYSCALL
void module_syscall_ptr_run(void);
#endif

#ifdef CONFIG_APP_MODULE_PSA
void module_psa_key_run(void);
#endif

#endif /* APP_MODULES_H */
```
